## Documentation/devicetree/bindings/clock/qcom,sm8350-videocc.yaml
```yaml
# SPDX-License-Identifier: (GPL-2.0-only OR BSD-2-Clause)
%YAML 1.2
---
$id: http://devicetree.org/schemas/clock/qcom,sm8350-videocc.yaml#
$schema: http://devicetree.org/meta-schemas/core.yaml#

title: Qualcomm SM8350 Video Clock & Reset Controller

maintainers:
  - Konrad Dybcio <konradybcio@kernel.org>

description: |
  Qualcomm video clock control module provides the clocks, resets and power
  domains on Qualcomm SoCs.

  See also:
    include/dt-bindings/clock/qcom,videocc-sm8350.h
    include/dt-bindings/reset/qcom,videocc-sm8350.h

properties:
  compatible:
    enum:
      - qcom,sc8280xp-videocc
      - qcom,sm8350-videocc

  clocks:
    items:
      - description: Board XO source
      - description: Board active XO source
      - description: Board sleep clock

  power-domains:
    minItems: 1
    items:
      - description: MMCX power domain
      - description: MXC power domain (SC8280XP only)

  required-opps:
    minItems: 1
    items:
      - description: Required MMCX performance point
      - description: Required MXC performance point (SC8280XP only)

required:
  - compatible
  - clocks
  - power-domains
  - required-opps

allOf:
  - $ref: qcom,gcc.yaml#
  - if:
      properties:
        compatible:
          const: qcom,sm8350-videocc
    then:
      properties:
        power-domains:
          maxItems: 1
  - if:
      properties:
        power-domains:
          minItems: 2
    then:
      properties:
        required-opps:
          minItems: 2
    else:
      properties:
        required-opps:
          maxItems: 1

unevaluatedProperties: false

examples:
  - |
    #include <dt-bindings/clock/qcom,rpmh.h>
    #include <dt-bindings/power/qcom,rpmhpd.h>

    clock-controller@abf0000 {
      compatible = "qcom,sm8350-videocc";
      reg = <0x0abf0000 0x10000>;
      clocks = <&rpmhcc RPMH_CXO_CLK>,
               <&rpmhcc RPMH_CXO_CLK_A>,
               <&sleep_clk>;
      power-domains = <&rpmhpd RPMHPD_MMCX>;
      required-opps = <&rpmhpd_opp_low_svs>;
      #clock-cells = <1>;
      #reset-cells = <1>;
      #power-domain-cells = <1>;
    };
...
```

## Documentation/devicetree/bindings/display/bridge/lontium,lt8712sx.yaml
```yaml
# SPDX-License-Identifier: (GPL-2.0-only OR BSD-2-Clause)
%YAML 1.2
---
$id: http://devicetree.org/schemas/display/bridge/lontium,lt8712sx.yaml#
$schema: http://devicetree.org/meta-schemas/core.yaml#

title: Lontium LT8712SX/LT8713SX DisplayPort to HDMI bridge

description:
  The LT8712SX and LT8713SX convert one DisplayPort input to up to two HDMI
  outputs. With a single sink connected, the bridge firmware routes the
  stream to whichever output is connected. With firmware that supports
  DisplayPort MST, the bridge acts as an MST branch device and each
  connected output is a separate MST sink.

maintainers:
  - Chen Jiali <chenjiali@radxa.com>

properties:
  compatible:
    enum:
      - lontium,lt8712sx
      - lontium,lt8713sx

  reg:
    maxItems: 1

  cec-port-names:
    $ref: /schemas/types.yaml#/definitions/string-array
    description:
      HDMI connector port names used to create named CEC notifiers for boards
      that route the CEC lines of the HDMI outputs to GPIO CEC adapters.
    minItems: 1
    maxItems: 2
    uniqueItems: true

  enable-gpios:
    maxItems: 1

  power-gpios:
    maxItems: 1

  pinctrl-0: true

  pinctrl-names:
    items:
      - const: default

  reset-gpios:
    maxItems: 1

  vdd-supply:
    description: Power supply for the bridge.

  ports:
    $ref: /schemas/graph.yaml#/properties/ports

    properties:
      port@0:
        $ref: /schemas/graph.yaml#/properties/port
        description: DisplayPort input.

      port@1:
        $ref: /schemas/graph.yaml#/properties/port
        description: First HDMI output.

      port@2:
        $ref: /schemas/graph.yaml#/properties/port
        description: Second HDMI output.

    required:
      - port@0
      - port@1

required:
  - compatible
  - reg
  - ports

additionalProperties: false

examples:
  - |
    #include <dt-bindings/gpio/gpio.h>

    i2c {
        #address-cells = <1>;
        #size-cells = <0>;

        hdmi-bridge@4f {
            compatible = "lontium,lt8712sx";
            reg = <0x4f>;
            cec-port-names = "HDMI0", "HDMI1";
            vdd-supply = <&vcc_3v3>;
            reset-gpios = <&gpio 1 GPIO_ACTIVE_LOW>;

            ports {
                #address-cells = <1>;
                #size-cells = <0>;

                port@0 {
                    reg = <0>;

                    bridge_in: endpoint {
                        remote-endpoint = <&dp_out>;
                    };
                };

                port@1 {
                    reg = <1>;

                    bridge_out0: endpoint {
                        remote-endpoint = <&hdmi0_connector_in>;
                    };
                };

                port@2 {
                    reg = <2>;

                    bridge_out1: endpoint {
                        remote-endpoint = <&hdmi1_connector_in>;
                    };
                };
            };
        };
    };

...
```
