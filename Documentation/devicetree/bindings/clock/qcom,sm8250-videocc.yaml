## drivers/media/i2c/rk628/Kconfig
```kconfig
# SPDX-License-Identifier: GPL-2.0-only
config VIDEO_RK628
	tristate
	select CEC_CORE
	select CEC_NOTIFIER
	select REGMAP_I2C
	select MEDIA_CONTROLLER
	help
	  Support for the Rockchip RK628 HDMI to MIPI CSI-2/BT1120 bridge.

	  To compile this driver as a module, choose M here: the
	  module will be called video-rk628.

config VIDEO_RK628_CSI
	tristate "Rockchip RK628_CSI decoder"
	depends on VIDEO_DEV && I2C && OF && COMMON_CLK && GPIOLIB
	depends on EXTCON
	select HDMI
	select V4L2_FWNODE
	select VIDEO_V4L2_SUBDEV_API
	select VIDEO_RK628
	help
	  Support for the Rockchip RK628 HDMI to MIPI CSI-2 bridge.

	  To compile this driver as a module, choose M here: the
	  module will be called rk628-csi.

config VIDEO_RK628_BT1120
	tristate "Rockchip RK628_BT1120 decoder"
	depends on VIDEO_DEV && I2C && OF && COMMON_CLK && GPIOLIB
	select HDMI
	select V4L2_FWNODE
	select VIDEO_V4L2_SUBDEV_API
	select VIDEO_RK628
	help
	  Support for the Rockchip RK628 HDMI to BT1120 bridge.

	  To compile this driver as a module, choose M here: the
	  module will be called rk628-bt1120.
```
