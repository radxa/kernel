## Documentation/devicetree/bindings/clock/qcom,sm8250-videocc.yaml
```yaml
# SPDX-License-Identifier: (GPL-2.0-only OR BSD-2-Clause)
%YAML 1.2
---
$id: http://devicetree.org/schemas/clock/qcom,sm8250-videocc.yaml#
$schema: http://devicetree.org/meta-schemas/core.yaml#

title: Qualcomm Video Clock & Reset Controller

maintainers:
  - Taniya Das <quic_tdas@quicinc.com>

description: |
  Qualcomm video clock control module provides the clocks, resets and power
  domains on Qualcomm SoCs.

  See also::
    include/dt-bindings/clock/qcom,videocc-sm8250.h

properties:
  compatible:
    oneOf:
      - enum:
          - qcom,sm8250-videocc

  clocks:
    items:
      - description: AHB
      - description: Board XO source
      - description: Board active XO source

  clock-names:
    items:
      - const: iface
      - const: bi_tcxo
      - const: bi_tcxo_ao

  power-domains:
    items:
      - description:
          A phandle and PM domain specifier for the MMCX power domain.
      - description:
          A phandle and PM domain specifier for the MX power domain.

  required-opps:
    items:
      - description:
          A phandle to an OPP node describing required MMCX performance point.
      - description:
          A phandle to an OPP node describing required MX performance point.

required:
  - compatible
  - clocks
  - clock-names
  - '#power-domain-cells'
  - power-domains
  - required-opps

allOf:
  - $ref: qcom,gcc.yaml#

unevaluatedProperties: false

examples:
  - |
    #include <dt-bindings/clock/qcom,rpmh.h>
    #include <dt-bindings/power/qcom,rpmhpd.h>
    clock-controller@ab00000 {
      compatible = "qcom,sm8250-videocc";
      reg = <0x0ab00000 0x10000>;
      clocks = <&gcc_gcc_video_ahb_clk>,
               <&rpmhcc RPMH_CXO_CLK>,
               <&rpmhcc RPMH_CXO_CLK_A>;
      clock-names = "iface",
                    "bi_tcxo",
                    "bi_tcxo_ao";
      #clock-cells = <1>;
      #reset-cells = <1>;
      #power-domain-cells = <1>;
      power-domains = <&rpmhpd RPMHPD_MMCX>,
                      <&rpmhpd RPMHPD_MX>;
      required-opps = <&rpmhpd_opp_low_svs>,
                      <&rpmhpd_opp_low_svs>;
    };
...
```

## Documentation/devicetree/bindings/display/bridge/lontium,lt8712sx.yaml
```yaml
# SPDX-License-Identifier: (GPL-2.0-only OR BSD-2-Clause)
%YAML 1.2
---
$id: http://devicetree.org/schemas/display/bridge/lontium,lt8712sx.yaml#
$schema: http://devicetree.org/meta-schemas/core.yaml#

title: Lontium LT8712SX/LT8713SX eDP to HDMI Bridge

maintainers:
  - Chen Jiali <chenjiali@radxa.com>

properties:
  compatible:
    enum:
      - lontium,lt8712sx
      - lontium,lt8713sx

  reg:
    maxItems: 1

  cec-port-names:
    $ref: /schemas/types.yaml#/definitions/string-array
    description:
      HDMI connector port names used to create named CEC notifiers for boards
      that route multiple HDMI CEC lines to GPIO CEC adapters.
    minItems: 1
    maxItems: 2
    uniqueItems: true

  enable-gpios:
    maxItems: 1

  power-gpios:
    maxItems: 1

  pinctrl-0: true

  pinctrl-names:
    items:
      - const: default

  reset-gpios:
    maxItems: 1

  vdd-supply:
    description: Power supply for the bridge.

  ports:
    $ref: /schemas/graph.yaml#/properties/ports

    properties:
      port@0:
        $ref: /schemas/graph.yaml#/properties/port
        description: eDP input port.

      port@1:
        $ref: /schemas/graph.yaml#/properties/port
        description: HDMI output port.

    required:
      - port@0
      - port@1

required:
  - compatible
  - reg
  - ports

additionalProperties: false

examples:
  - |
    #include <dt-bindings/gpio/gpio.h>

    i2c {
        #address-cells = <1>;
        #size-cells = <0>;

        hdmi-bridge@4f {
            compatible = "lontium,lt8712sx";
            reg = <0x4f>;
            cec-port-names = "HDMI0", "HDMI1";
            vdd-supply = <&vcc_3v3>;
            reset-gpios = <&gpio 1 GPIO_ACTIVE_LOW>;

            ports {
                #address-cells = <1>;
                #size-cells = <0>;

                port@0 {
                    reg = <0>;

                    bridge_in: endpoint {
                        remote-endpoint = <&edp_out>;
                    };
                };

                port@1 {
                    reg = <1>;

                    bridge_out: endpoint {
                        remote-endpoint = <&hdmi_connector_in>;
                    };
                };
            };
        };
    };

...
```

## Documentation/devicetree/bindings/media/i2c/onnn,ar0234.yaml
```yaml
# SPDX-License-Identifier: (GPL-2.0-only OR BSD-2-Clause)
%YAML 1.2
---
$id: http://devicetree.org/schemas/media/i2c/onnn,ar0234.yaml#
$schema: http://devicetree.org/meta-schemas/core.yaml#

title: ON Semiconductor AR0234 1/2.6-inch CMOS Digital Image Sensor

maintainers:
  - Alexander Shiyan <eagle.alexander923@gmail.com>

description:
  The AR0234 is a 1/2.6-inch CMOS digital image sensor with a pixel
  array of 1940x1220 pixels, capable of 1920x1200 resolution at up
  to 120 fps. It supports MIPI CSI-2 output with 2 or 4 data lanes,
  color raw Bayer (8/10-bit) or monochrome output.

allOf:
- $ref: /schemas/media/video-interface-devices.yaml#

properties:
  compatible:
    enum:
      - onnn,ar0234cssc
      - onnn,ar0234cssm
      - onnn,ar0234cs
    description:
      The AR0234 sensor exists in two different models, a colour variant
      (AR0234CSSC) and a monochrome variant (AR0234CSSM). The device exposes
      the model through registers, allowing for auto-detection with a common
      "onnn,ar0234cs" compatible string.

  reg:
    description: I2C device address
    maxItems: 1

  clocks:
    description: Reference clock (external clock) input
    maxItems: 1

  reset-gpios:
    description: Reset pin, usually active low (if needed)
    maxItems: 1

  vaa-supply:
    description: Analog (2.8V) supply regulator

  vdd-supply:
    description: Digital Core (1.2V) supply regulator

  vddio-supply:
    description: I/O (1.8V-2.8V) supply regulator

  port:
    $ref: /schemas/graph.yaml#/$defs/port-base
    description: CSI-2 transmitter port
    additionalProperties: false

    properties:
      endpoint:
        $ref: /schemas/media/video-interfaces.yaml#
        unevaluatedProperties: false

        properties:
          data-lanes:
            oneOf:
              - items:
                  - const: 1
                  - const: 2
              - items:
                  - const: 1
                  - const: 2
                  - const: 3
                  - const: 4

          link-frequencies: true

        required:
          - data-lanes
          - link-frequencies

    required:
      - endpoint

required:
  - compatible
  - reg
  - clocks
  - port

additionalProperties: false

examples:
  - |
    #include <dt-bindings/gpio/gpio.h>

    i2c {
        #address-cells = <1>;
        #size-cells = <0>;

        camera@18 {
            compatible = "onnn,ar0234cs";
            reg = <0x18>;
            pinctrl-names = "default";
            pinctrl-0 = <&pinctrl_cam>;
            clocks = <&clk27m>;
            vaa-supply = <&reg_cam_vaa>;
            vdd-supply = <&reg_cam_vdd>;
            vddio-supply = <&reg_cam_vddio>;
            reset-gpios = <&gpio3 4 GPIO_ACTIVE_LOW>;

            port {
                ar0234_out: endpoint {
                    data-lanes = <1 2 3 4>;
                    link-frequencies = /bits/ 64 <360000000 450000000>;
                    remote-endpoint = <&ar0234_in>;
                };
            };
        };
    };
...
```

## Documentation/devicetree/bindings/media/i2c/rk628.txt
```
Rockchip RK628 HDMI to MIPI CSI-2 bridge
======================================

The RK628 receives HDMI video and transmits it over MIPI CSI-2. Its
registers are accessed over I2C.

Required properties:
- compatible: "rockchip,rk628-csi-v4l2"
- reg: I2C address, normally 0x50
- reset-gpios: reset pin, active low
- port: CSI-2 output port containing an endpoint with data-lanes and
  remote-endpoint. Data lanes are numbered consecutively from 1, and the
  clock lane is 0.

Optional properties:
- clocks: external 24 MHz reference clock. Omit for a module with its own
  oscillator and no reference clock connection to the host.
- clock-names: "soc_24M", required when clocks is present
- enable-gpios: module enable pin
- power-gpios: module power control pin
- plugin-det-gpios: HDMI 5 V detection pin
- interrupts: HDMI receiver interrupt. Without this property the driver
  polls receiver interrupt status.
- continues-clk: use continuous CSI-2 clock mode (legacy property spelling)
- hpd-output-inverted: invert the HDMI HPD output
- cec-enable: enable the CEC adapter
- i2s-enable-default: keep the audio I2S output enabled
- hdcp-enable: enable HDCP 1.x using provisioned keys from NVMEM
- nvmem-cells: phandle to an HDCP key cell when HDCP is enabled
- nvmem-cell-names: "hdcp". The cell contains 308 bytes of HDCP key data
  followed by 2 seed bytes, in the vendor driver's original format.
- rockchip,camera-module-index: optional module index, defaults to 0
- rockchip,camera-module-facing: optional label, defaults to "front"
- rockchip,camera-module-name: optional label, defaults to "rk628"
- rockchip,camera-module-lens-name: optional label, defaults to "none"

For other endpoint properties see media/video-interfaces.yaml.

Example for a module using its own reference clock and no interrupt pin:

    hdmi-receiver@50 {
        compatible = "rockchip,rk628-csi-v4l2";
        reg = <0x50>;
        reset-gpios = <&tlmm 15 GPIO_ACTIVE_LOW>;
        continues-clk;

        port {
            rk628_out: endpoint {
                clock-lanes = <0>;
                data-lanes = <1 2 3 4>;
                remote-endpoint = <&csiphy3_ep>;
            };
        };
    };
```
