## Documentation/devicetree/bindings/leds/worldsemi,ws2812b.yaml
```yaml
# SPDX-License-Identifier: (GPL-2.0-only OR BSD-2-Clause)
%YAML 1.2
---
$id: http://devicetree.org/schemas/leds/worldsemi,ws2812b.yaml#
$schema: http://devicetree.org/meta-schemas/core.yaml#

title: WS2812B LEDs driven using SPI

maintainers:
  - Chuanhong Guo <gch981213@gmail.com>

description: |
  WorldSemi WS2812B is a individually addressable LED chip that can be chained
  together and controlled individually using a single wire.
  This binding describes a chain of WS2812B LEDs connected to the SPI MOSI pin.
  Typical setups includes connecting the data pin of the LED chain to MOSI as
  the only device or using CS and MOSI with a tri-state voltage-level shifter
  for the data pin.
  The SPI frequency needs to be 2.105MHz~2.85MHz for the timing to be correct
  and the controller needs to send all the bytes continuously.

allOf:
  - $ref: /schemas/spi/spi-peripheral-props.yaml#

properties:
  compatible:
    const: worldsemi,ws2812b

  reg:
    maxItems: 1

  spi-max-frequency:
    minimum: 2105000
    maximum: 2850000

  "#address-cells":
    const: 1

  "#size-cells":
    const: 0

patternProperties:
  "^multi-led@[0-9a-f]+$":
    type: object
    $ref: leds-class-multicolor.yaml#
    unevaluatedProperties: false

    properties:
      color-index:
        description: |
          A 3-item array specifying color of each components in this LED. It
          should be one of the LED_COLOR_ID_* prefixed definitions from the
          header include/dt-bindings/leds/common.h. Defaults to
          <LED_COLOR_ID_GREEN LED_COLOR_ID_RED LED_COLOR_ID_BLUE>
          if unspecified.
        $ref: /schemas/types.yaml#/definitions/uint32-array
        maxItems: 3

      reg:
        description: |
          Which LED this node represents. The reg of the first LED on the chain
          is 0.
        maxItems: 1

    required:
      - reg
      - color
      - function

required:
  - compatible

additionalProperties: false

examples:
  - |
    #include <dt-bindings/leds/common.h>
    spi {
        #address-cells = <1>;
        #size-cells = <0>;

        led-controller@0 {
            compatible = "worldsemi,ws2812b";
            reg = <0>;
            #address-cells = <1>;
            #size-cells = <0>;
            spi-max-frequency = <2850000>;
            multi-led@0 {
                reg = <0>;
                color-index = <LED_COLOR_ID_RED LED_COLOR_ID_GREEN LED_COLOR_ID_BLUE>;
                color = <LED_COLOR_ID_RGB>;
                function = LED_FUNCTION_STATUS;
                function-enumerator = <0>;
            };
            multi-led@1 {
                reg = <1>;
                color = <LED_COLOR_ID_RGB>;
                function = LED_FUNCTION_STATUS;
                function-enumerator = <1>;
            };
            multi-led@2 {
                reg = <2>;
                color = <LED_COLOR_ID_RGB>;
                function = LED_FUNCTION_STATUS;
                function-enumerator = <2>;
            };
            multi-led@3 {
                reg = <3>;
                color = <LED_COLOR_ID_RGB>;
                function = LED_FUNCTION_STATUS;
                function-enumerator = <3>;
            };
        };
    };

...
```

## Documentation/devicetree/bindings/net/qca,qca808x.yaml
```yaml
# SPDX-License-Identifier: GPL-2.0-only OR BSD-2-Clause
%YAML 1.2
---
$id: http://devicetree.org/schemas/net/qca,qca808x.yaml#
$schema: http://devicetree.org/meta-schemas/core.yaml#

title: Qualcomm Atheros QCA808X PHY

maintainers:
  - Christian Marangi <ansuelsmth@gmail.com>

description:
  QCA808X PHYs can have up to 3 LEDs attached.
  All 3 LEDs are disabled by default.
  2 LEDs have dedicated pins with the 3rd LED having the
  double function of Interrupt LEDs/GPIO or additional LED.

  By default this special PIN is set to LED function.

allOf:
  - $ref: ethernet-phy.yaml#

properties:
  compatible:
    enum:
      - ethernet-phy-id004d.d101

  qca,led-mode:
    $ref: /schemas/types.yaml#/definitions/uint32
    description: |
      Select one of the vendor-defined LED preset modes described in the
      datasheet. The selected mode programs the MMD7 LED control registers for
      all three PHY LED outputs during PHY initialization.
    enum:
      - 1
      - 2
      - 3

  wakeup-gpios:
    maxItems: 1
    description:
      GPIO connected to the active-low INTn_WOL output for Wake-on-LAN.

unevaluatedProperties: false

examples:
  - |
    #include <dt-bindings/gpio/gpio.h>
    #include <dt-bindings/leds/common.h>

    mdio {
        #address-cells = <1>;
        #size-cells = <0>;

        ethernet-phy@0 {
            compatible = "ethernet-phy-id004d.d101";
            reg = <0>;
            qca,led-mode = <2>;
            wakeup-gpios = <&gpio 1 GPIO_ACTIVE_LOW>;

            leds {
                #address-cells = <1>;
                #size-cells = <0>;

                led@0 {
                    reg = <0>;
                    color = <LED_COLOR_ID_GREEN>;
                    function = LED_FUNCTION_WAN;
                    default-state = "keep";
                };
            };
        };
    };
```

## Documentation/devicetree/bindings/pwm/clk-pwm.yaml
```yaml
# SPDX-License-Identifier: GPL-2.0-only OR BSD-2-Clause
%YAML 1.2
---
$id: http://devicetree.org/schemas/pwm/clk-pwm.yaml#
$schema: http://devicetree.org/meta-schemas/core.yaml#

title: Clock based PWM controller

maintainers:
  - Nikita Travkin <nikita@trvn.ru>

description: |
  Some systems have clocks that can be exposed to external devices.
  (e.g. by muxing them to GPIO pins)
  It's often possible to control duty-cycle of such clocks which makes them
  suitable for generating PWM signal.

  Optionally, a GPIO and pinctrl states can be provided. When a constant
  output level is needed (0%, 100%, or disabled), the pin is switched to
  GPIO mode to drive the level directly. For normal PWM output the pin is
  switched back to its clock function mux.

allOf:
  - $ref: pwm.yaml#

properties:
  compatible:
    const: clk-pwm

  clocks:
    description: Clock used to generate the signal.
    maxItems: 1

  "#pwm-cells":
    const: 2

  gpios:
    description:
      Optional GPIO used to drive a constant level when the PWM output is
      disabled or set to 0% / 100% duty cycle. When provided, pinctrl states
      "default" (clock mux) and "gpio" must also be defined.
    maxItems: 1

  pinctrl-names: true

  pinctrl-0:
    description: Pin configuration for clock function mux (normal PWM).
    maxItems: 1

  pinctrl-1:
    description: Pin configuration for GPIO mode (constant level output).
    maxItems: 1

dependencies:
  gpios: [ pinctrl-0, pinctrl-1 ]

unevaluatedProperties: false

required:
  - compatible
  - clocks

examples:
  - |
    pwm {
      compatible = "clk-pwm";
      #pwm-cells = <2>;
      clocks = <&gcc 0>;
    };

  - |
    pwm {
      compatible = "clk-pwm";
      #pwm-cells = <2>;
      clocks = <&gcc 0>;
      pinctrl-names = "default", "gpio";
      pinctrl-0 = <&pwm_clk_flash_default>;
      pinctrl-1 = <&pwm_clk_flash_gpio>;
      gpios = <&tlmm 32 0>;
    };
```

## drivers/net/ethernet/realtek/r8125_vendor/Kconfig
```kconfig
config R8125
        tristate "Realtek 8125A/8125B/8168KB ethernet support by vendor"
        depends on PCI
        select FW_LOADER
        select CRC32
        select PHYLIB
        select REALTEK_PHY
	select OF
        help
          Say Y here if you have a Realtek Ethernet adapter belonging to
          the following families:
          RTL8125A 2.5GBit Ethernet
          RTL8125B 2.5GBit Ethernet
          RTL8168KB 2.5GBit Ethernet

          To compile this driver as a module, choose M here: the module
          will be called r8125.  This is recommended.

config R8125_SOC_LAN
        bool "Enable HW optimize"
	default n
        depends on R8125
        help
          This enables CONFIG_SOC_LAN flag, if enabled, 
	  will skip PCI configuration space offset 0x79 settings
	  If unsure, say N.

config R8125_REALWOW_SUPPORT
        bool "Enable Realtek RealWOW Technology"
	default n
        depends on R8125
        help
          This enables Realtek RealWOW Technology.
	  If unsure, say N.

config R8125_DASH_SUPPORT
        bool "Enable Realtek Dash Management Console"
	default n
        depends on R8125
        help
          This enables Realtek Dash Management Console.
	  If unsure, say N.

config R8125_DASH_PRINT_SUPPORT
        bool "Enable Realtek Dash Print"
	default n
        depends on R8125
	depends on R8125_DASH_SUPPORT
        help
          This enables Realtek Dash Print.
	  If unsure, say N.

config R8125_DOWN_SPEED_100
        bool "Down speed 100"
	default n
        depends on R8125
        help
          This enables CONFIG_DOWN_SPEED_100 flag.
	  If unsure, say N.

config R8125_ASPM
        bool "Support PCIE ASPM"
	default y
        depends on R8125
        help
          Support Active-state power management (ASPM).
	  If unsure, say Y.

config R8125_S5WOL
        bool "Support Wake On LAN"
	default y
        depends on R8125
        help
          Support Wake On LAN.
	  If unsure, say Y.

config R8125_S5_KEEP_CURR_MAC
        bool "keep mac on after shutdown"
	default n
        depends on R8125
        help
          If enabled, will keep the mac on after shutdown.
	  If unsure, say N.

config R8125_EEE
        bool "Support Energy-Efficient Ethernet (EEE)"
	default y
        depends on R8125
        help
          Support Energy-Efficient Ethernet (EEE).
	  If unsure, say Y.

config R8125_S0_MAGIC_PACKET
        bool "Enable Magic Packet"
	default n
        depends on R8125
        help
          Enable magic packet.
	  If unsure, say N.

config R8125_TX_NO_CLOSE
        bool "Enable TX_NO_CLOSE"
	default y
        depends on R8125
        help
	  If unsure, say Y.

config R8125_MULTI_MSIX_VECTOR
        bool "Enable Multi MSIX Vector"
	default y
        depends on R8125
        help
	  If unsure, say Y.

config R8125_MULTIPLE_RX_QUEUE
        bool "Enable Multiple rx queue"
	default y
        depends on R8125
	depends on R8125_MULTI_MSIX_VECTOR
        help
	  If unsure, say Y.

config R8125_MULTIPLE_TX_QUEUE
        bool "Enable Multiple tx queue"
	default y
        depends on R8125
	depends on R8125_MULTI_MSIX_VECTOR
        help
	  If unsure, say Y.

config R8125_PTP_SUPPORT
        bool "Support PTP clock"
	default n
	depends on PTP_1588_CLOCK
        depends on R8125
        help
	  Support IEEE 1588 PTP Clock.

config R8125_PTP_MASTER_MODE
        bool "Enable PTP Master mode"
	default n
        depends on R8125
	depends on R8125_PTP_SUPPORT
        help
	  Enable PTP master mode.

config R8125_USE_FIRMWARE_FILE
        bool "Use firmware file"
	default n
        depends on R8125
        help
	  Use firmware file.
	  If unsure, say N.

config R8125_PM_SUPPORT
        bool "Enable PM Support"
	default y
        depends on R8125
        help
	  Enable PM Support.
	  If unsure, say Y.
```

## drivers/net/wireless/aic/aic8800_usb/Kconfig
```kconfig
config AIC_WLAN_AIC8800_USB
	bool "AIC wireless Support"
	default n
	help
	  This is support for aic wireless chip.

if AIC_WLAN_AIC8800_USB
source "drivers/net/wireless/aic/aic8800_usb/aic8800_fdrv/Kconfig"
source "drivers/net/wireless/aic/aic8800_usb/aic_load_fw/Kconfig"
endif
```

## drivers/net/wireless/broadcom/brcm80211/Kconfig
```kconfig
# SPDX-License-Identifier: GPL-2.0-only
config BRCMUTIL
	tristate

config BRCMSMAC
	tristate "Broadcom IEEE802.11n PCIe SoftMAC WLAN driver"
	depends on MAC80211
	depends on BCMA_POSSIBLE
	select BCMA
	select BRCMUTIL
	select FW_LOADER
	select CORDIC
	help
	  This module adds support for PCIe wireless adapters based on Broadcom
	  IEEE802.11n SoftMAC chipsets. If you choose to build a module, the
	  driver will be called brcmsmac.ko.

config BRCMSMAC_LEDS
	def_bool BRCMSMAC && BCMA_DRIVER_GPIO && MAC80211_LEDS
	help
	  The brcmsmac LED support depends on the presence of the
	  BCMA_DRIVER_GPIO driver, and it only works if LED support
	  is enabled and reachable from the driver module.

source "drivers/net/wireless/broadcom/brcm80211/brcmfmac/Kconfig"

config BRCM_TRACING
	bool "Broadcom device tracing"
	depends on BRCMSMAC || BRCMFMAC
	help
	  If you say Y here, the Broadcom wireless drivers will register
	  with ftrace to dump event information into the trace ringbuffer.
	  Tracing can be enabled at runtime to aid in debugging wireless
	  issues. This option adds a small amount of overhead when tracing
	  is disabled. If unsure, say Y to allow developers to better help
	  you when wireless problems occur.

config BRCMDBG
	bool "Broadcom driver debug functions"
	depends on BRCMSMAC || BRCMFMAC
	select WANT_DEV_COREDUMP
	help
	  Selecting this enables additional code for debug purposes.

config BRCMFMAC_PCIE_BARWIN_SZ
	bool "Custom PCIE BAR window size support for FullMAC driver"
	depends on BRCMFMAC
	depends on PCI
	default n
	help
	  If you say Y here, the FMAC driver will use custom PCIE BAR
	  window size. Say Y to allow developers to use custom PCIE
	  BAR window size when HOST PCIE IP can support less then 4MB
	  BAR window.

config BRCMFMAC_BT_SHARED_SDIO
	bool "FMAC shares SDIO bus to Bluetooth"
	depends on BRCMFMAC
	depends on BRCMFMAC_SDIO
	default n
	help
	  Selecting this to enables sharing the SDIO bus interface between
	  Cypress BT and WiFi host drivers.
```
