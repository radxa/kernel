/dts-v1/;
/plugin/;

/ {
	compatible = "rockchip,rk3308";

	fragment@0 {
		target = <&pwm2>;
		__overlay__ {
			status = "disabled";
		};
	};

	fragment@1 {
		target = <&pwm3>;
		__overlay__ {
			status = "disabled";
		};
	};

	fragment@2 {
		target = <&i2c3>;
		__overlay__ {
			status = "okay";
			pinctrl-names = "default";
			pinctrl-0 = <&i2c3m1_xfer>;
		};
	};
};
