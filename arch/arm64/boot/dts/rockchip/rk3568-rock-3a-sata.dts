// SPDX-License-Identifier: (GPL-2.0+ OR MIT)
/*
 * Copyright (c) 2024 Rockchip Electronics Co., Ltd.
 * Copyright (c) 2024 Radxa Computer (Shenzhen) Co., Ltd.
 *
 */

/dts-v1/
#include "rk3568-rock-3a.dts"

/ {
	compatible = "radxa,rock-3a-sata", "radxa,rock-3a", "rockchip,rk3568";
};

&pcie2x1 {
	status = "disabled";
};

&sata2 {
	status = "okay";
};
