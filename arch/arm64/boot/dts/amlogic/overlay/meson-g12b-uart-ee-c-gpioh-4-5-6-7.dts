/dts-v1/;
/plugin/;

/ {
	compatible = "radxa,zero2", "amlogic,a311d", "amlogic,g12b";

	fragment@0 {
		target = <&uart_C>;
		__overlay__ {
			status = "okay";
			pinctrl-0 = <&uart_c_pins &uart_c_cts_rts_pins>;
			pinctrl-names = "default";
		};
	};
};