/dts-v1/;
/plugin/;

/ {
	compatible = "radxa,zero2", "amlogic,a311d", "amlogic,g12b";

	fragment@0 {
		target = <&i2c0>;
		__overlay__ {
			status = "okay";
			pinctrl-0 = <&i2c0_sck_z1_pins &i2c0_sda_z0_pins>;
			pinctrl-names = "default";
		};
	};
};